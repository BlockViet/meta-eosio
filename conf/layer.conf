## conf/layer.conf
```bitbake
# We have a conf and classes directory, add to BBPATH
BBPATH .= ":${LAYERDIR}"

# We have recipes-* directories, add to BBFILES
BBFILES += "${LAYERDIR}/recipes-*/*/*.bb ${LAYERDIR}/recipes-*/*/*.bbappend"

BBFILE_COLLECTIONS += "eosio"
BBFILE_PATTERN_eosio = "^${LAYERDIR}/"
BBFILE_PRIORITY_eosio = "1"

# This should only be incremented on significant changes that will
# cause compatibility issues with other layers
LAYERVERSION_eosio = "1"

LAYERDEPENDS_eosio = "core wasm"

LAYERSERIES_COMPAT_eosio = "sumo"
```
